## virtualization/tinyemu/Kconfig
```kconfig
#
# For a description of the syntax of this configuration file,
# see the file kconfig-language.txt in the NuttX tools repository.
#

menuconfig VIRTUALIZATION_TINYEMU
	bool "TinyEMU"
	default n
	---help---
		Enable support for running TinyEMU as an application on NuttX.

if VIRTUALIZATION_TINYEMU

config VIRTUALIZATION_TINYEMU_PROGNAME
	string "TinyEMU program name"
	default "tinyemu"
	---help---
		This is the name of the program that will be used when the NSH ELF
		program is installed.

config VIRTUALIZATION_TINYEMU_PRIORITY
	int "TinyEMU task priority"
	default 100

config VIRTUALIZATION_TINYEMU_STACKSIZE
	int "TinyEMU stack size"
	default 8192

endif # VIRTUALIZATION_TINYEMU
```
