## examples/i2csoak/Kconfig
```kconfig
#
# For a description of the syntax of this configuration file,
# see the file kconfig-language.txt in the NuttX tools repository.
#

config EXAMPLES_I2CSOAK
	tristate "I2C slave soak test"
	default n
	depends on I2C_DRIVER
	---help---
		Hammer a known-answer register on an I2C slave and count how often
		the answer comes back wrong.  Intended for measuring a slave
		implementation: the register read never changes, so every mismatch
		is a transport fault.

		Exercises both a STOP between the register select and the read, and
		a repeated START, because slave implementations frequently handle
		only one of the two correctly.

if EXAMPLES_I2CSOAK

config EXAMPLES_I2CSOAK_PROGNAME
	string "Program name"
	default "i2csoak"

config EXAMPLES_I2CSOAK_PRIORITY
	int "i2csoak task priority"
	default 100

config EXAMPLES_I2CSOAK_STACKSIZE
	int "i2csoak stack size"
	default DEFAULT_TASK_STACKSIZE

endif
```

## examples/misbehave/Kconfig
```kconfig
#
# For a description of the syntax of this configuration file,
# see the file kconfig-language.txt in the NuttX tools repository.
#

config EXAMPLES_MISBEHAVE
	tristate "Application misbehaviour containment test"
	default n
	---help---
		A test that has an application do the things a broken or hostile one
		does -- dereference NULL, load from an unaligned address, divide by
		zero, call into garbage, overflow its stack, abort() -- and checks
		that each one takes only the offending task with it.

		This is the complement to EXAMPLES_SANDBOX.  That one asks whether a
		task can reach memory it does not own; this one asks whether the
		system survives what a task does to itself.  A boundary can be
		enforced perfectly and the kernel still panic on the fault that
		enforced it.

		Whether a given operation faults at all is architecture-specific --
		ARMv7-A permits unaligned loads, RISC-V does not trap integer divide
		by zero -- so an operation that simply completes is reported and is
		not a failure.  The failure is the system not surviving.

if EXAMPLES_MISBEHAVE

config EXAMPLES_MISBEHAVE_PROGNAME
	string "Program name"
	default "misbehave"

config EXAMPLES_MISBEHAVE_PRIORITY
	int "misbehave task priority"
	default 100

config EXAMPLES_MISBEHAVE_STACKSIZE
	int "misbehave stack size"
	default DEFAULT_TASK_STACKSIZE

endif
```

## examples/pmstress/Kconfig
```kconfig
#
# For a description of the syntax of this configuration file,
# see the file kconfig-language.txt in the NuttX tools repository.
#

config EXAMPLES_PMSTRESS
	tristate "Power management current staircase"
	default n
	depends on PM
	---help---
		Walk the power management states in a fixed, self-timed sequence so
		that a supply with current logging can record the whole run with no
		debugger, no console and no host attached.

		Each state is held for a known time and the steps are separated by a
		short full-speed burst, which appears in the trace as a spike and
		makes the recording self-describing.  The deepest state comes last
		and is held until the board is powered off.

if EXAMPLES_PMSTRESS

config EXAMPLES_PMSTRESS_PROGNAME
	string "Program name"
	default "pmstress"

config EXAMPLES_PMSTRESS_PRIORITY
	int "Task priority"
	default 100

config EXAMPLES_PMSTRESS_STACKSIZE
	int "Stack size"
	default DEFAULT_TASK_STACKSIZE

config EXAMPLES_PMSTRESS_STEP_SECS
	int "Seconds to hold each state"
	default 30
	---help---
		Long enough that the plateau is unambiguous in the log and that any
		slow settling has finished before the reading is taken.

config EXAMPLES_PMSTRESS_DISCONNECT_SECS
	int "Seconds to wait before starting"
	default 30
	---help---
		Grace period between describing the run on the console and starting
		it, so that the debugger and console can be unplugged first.  An
		attached debugger holds power domains up and would otherwise set the
		floor for every reading.

config EXAMPLES_PMSTRESS_LEDPATH
	string "User LED device"
	default "/dev/userleds"
	depends on USERLED_LOWER
	---help---
		Device used to drive the indicator LEDs off before the run.

endif
```

## examples/pmu/Kconfig
```kconfig
#
# For a description of the syntax of this configuration file,
# see the file kconfig-language.txt in the NuttX tools repository.
#

config EXAMPLES_PMU
	tristate "I2C slave soak test"
	default n
	depends on I2C_DRIVER
	---help---
		Hammer a known-answer register on an I2C slave and count how often
		the answer comes back wrong.  Intended for measuring a slave
		implementation: the register read never changes, so every mismatch
		is a transport fault.

		Exercises both a STOP between the register select and the read, and
		a repeated START, because slave implementations frequently handle
		only one of the two correctly.

if EXAMPLES_PMU

config EXAMPLES_PMU_PROGNAME
	string "Program name"
	default "pmu"

config EXAMPLES_PMU_PRIORITY
	int "pmu task priority"
	default 100

config EXAMPLES_PMU_STACKSIZE
	int "pmu stack size"
	default DEFAULT_TASK_STACKSIZE

endif
```

## system/kbdbridge/Kconfig
```kconfig
#
# For a description of the syntax of this configuration file,
# see the file kconfig-language.txt in the NuttX tools repository.
#

config SYSTEM_KBDBRIDGE
	tristate "Keyboard to NX bridge"
	default n
	depends on NX && NX_KBD && INPUT_KEYBOARD
	---help---
		Read a keyboard registered through the INPUT_KEYBOARD upper half
		and feed it to the NX server with nx_kbdin(), so that NX can route
		keystrokes to the window that has focus.

		NX has no keyboard driver of its own, so without something like this
		an NxTerm can only take input from whatever device it was given as
		stdin -- usually the serial console.

		Enable CONFIG_NXTERM_NXKBDIN as well for an NxTerm to accept the
		injected characters.

if SYSTEM_KBDBRIDGE

config SYSTEM_KBDBRIDGE_PROGNAME
	string "Program name"
	default "kbdbridge"

config SYSTEM_KBDBRIDGE_DEVPATH
	string "Default keyboard device"
	default "/dev/kbd0"

config SYSTEM_KBDBRIDGE_PRIORITY
	int "kbdbridge task priority"
	default 100

config SYSTEM_KBDBRIDGE_STACKSIZE
	int "kbdbridge stack size"
	default DEFAULT_TASK_STACKSIZE

endif
```

## system/mp3play/Kconfig
```kconfig
#
# For a description of the syntax of this configuration file,
# see the file kconfig-language.txt in the NuttX tools repository.
#

config SYSTEM_MP3PLAY
	tristate "MP3 player"
	default n
	depends on AUDIOUTILS_LIBMAD && AUDIOUTILS_NXAUDIO_LIB
	---help---
		Decode an MP3 file with libmad and play it through an audio
		device that takes PCM.  This is software decoding, for devices
		that cannot decode the bitstream themselves; nxplayer's MP3
		support hands the bitstream to the device instead.

		The decoder runs in the audio message loop, filling each buffer
		as the device gives it back, and reports what fraction of
		realtime the decoding cost when the file ends.

if SYSTEM_MP3PLAY

config SYSTEM_MP3PLAY_PROGNAME
	string "Program name"
	default "mp3play"

config SYSTEM_MP3PLAY_PRIORITY
	int "Task priority"
	default 100

config SYSTEM_MP3PLAY_STACKSIZE
	int "Stack size"
	default DEFAULT_TASK_STACKSIZE

config SYSTEM_MP3PLAY_DECODESTACK
	int "Decoder thread stack size"
	default 8192
	---help---
		The thread that runs the audio message loop and, inside it, the
		decoder.  libmad keeps its large state on the heap here, but the
		layer III routines still want a few kilobytes of stack.

endif
```

## system/usbsh/Kconfig
```kconfig
#
# For a description of the syntax of this configuration file,
# see the file kconfig-language.txt in the NuttX tools repository.
#

config SYSTEM_USBSH
	tristate "Shell on the USB serial port"
	default n
	depends on CDCACM && NSH_LIBRARY && !CDCACM_CONSOLE
	---help---
		Run a second NSH session on a USB CDC/ACM port.

		This is for boards whose console is something slow or intrusive
		-- a debug probe's RTT link, which halts the CPU on every access
		-- where a fast terminal is wanted without giving up the one
		that already works.  Both sessions see the same filesystem.

		If the USB port should be the console instead, use
		CDCACM_CONSOLE and NSH_USBCONSOLE; this is the other choice.

if SYSTEM_USBSH

config SYSTEM_USBSH_PROGNAME
	string "Program name"
	default "usbsh"

config SYSTEM_USBSH_MINOR
	int "CDC/ACM minor number"
	default 0

config SYSTEM_USBSH_DEVNAME
	string "Device path"
	default "/dev/ttyACM0"

config SYSTEM_USBSH_PRIORITY
	int "Task priority"
	default 100

config SYSTEM_USBSH_STACKSIZE
	int "Stack size"
	default 4096
	---help---
		This task runs the shell itself, not just the plumbing, so it
		needs what NSH needs.  Measured at 92% of 2048 with stack
		colouration on, which is too close to be worth saving 2 KB over.

endif
```
